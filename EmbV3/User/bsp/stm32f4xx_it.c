/*
*********************************************************************************************************
*
*	模块名称 : 中断模块
*	文件名称 : stm32f4xxx_it.c
*	版    本 : V1.1
*	说    明 : 本文件存放中断服务函数。
*
*			我们只需要添加需要的中断函数即可。一般中断函数名是固定的，除非您修改了启动文件中的函数名
*				\Libraries\CMSIS\Device\ST\STM32F4xx\Source\Templates\arm\startup_stm32f4xx.s
*
*			启动文件是汇编语言文件，定了每个中断的服务函数，这些函数使用了WEAK 关键字，表示弱定义，因此如
*			果我们在c文件中重定义了该服务函数（必须和它同名），那么启动文件的中断函数将自动无效。这也就
*			函数重定义的概念。
*
*			为了加强模块化，我们建议将中断服务程序分散到对应的驱动模块文件中。比如systick中断服务程序
*			放在 bsp_timer.c 文件中。
*
*	修改记录 :
*		版本号  日期       作者    说明
*		v1.0    2013-02-01 armfly  首版
*		v1.0    2013-06-20 armfly  在硬件异常中断服务程序中增加打印错误信息的功能。
*
*	Copyright (C), 2013-2014, 安富莱电子 www.armfly.com
*
*********************************************************************************************************
*/

#include "stm32f4xx_it.h"
#include <stdio.h>
#include "cmsis_os.h"

#define ERR_INFO "\r\nEnter HardFault_Handler, System Halt.\r\n"

__IO uint32_t MySysTick=0;

s8 Bsp_printf(char *fmt,...);

extern u8 testCnt[10];


/*
*********************************************************************************************************
*	Cortex-M3 内核异常中断服务程序
*********************************************************************************************************
*/
//void CAN1_RX0_IRQHandler(void)
//{
//u8 ff;
//}
/*
*********************************************************************************************************
*	函 数 名: NMI_Handler
*	功能说明: 不可屏蔽中断服务程序。
*	形    参: 无
*	返 回 值: 无
*********************************************************************************************************
*/
void NMI_Handler(void)
{
}

/*
*********************************************************************************************************
*	函 数 名: HardFault_Handler
*	功能说明: 硬件故障中断服务程序。其他异常处理被关闭，而又发生了异常，则触发。
*			  执行异常处理时，发生了异常，则触发。复位时默认使能。
*	形    参: 无
*	返 回 值: 无
*********************************************************************************************************
*/

void HardFaultHandle(unsigned int *arg)
{
	//unsigned int stacked_r0,stacked_r1,stacked_r2,stacked_r3,stacked_r12,stacked_lr,stacked_pc,stacked_psr;

	//if(CoreDebug->DHCSR & 1)
	//{
			//__breakpoint(0);
	//}
    //Bsp_printf("t0:%d,t1:%d,t2:%d,t3:%d,t4:%d.",testCnt[0],testCnt[1],testCnt[2],testCnt[3],testCnt[4]);
	/*
	stacked_r0 = ((unsigned long)arg[0]);
	stacked_r1 = ((unsigned long)arg[1]);
	stacked_r2 = ((unsigned long)arg[2]);
	stacked_r3 = ((unsigned long)arg[3]);
	stacked_r12 = ((unsigned long)arg[4]);
	stacked_lr = ((unsigned long)arg[5]);
	stacked_pc = ((unsigned long)arg[6]);
	stacked_psr = ((unsigned long)arg[7]);
	
	Bsp_printf("HardFault:R0=0x%x,R1=0x%x,R2=0x%x,R3=0x%x,R12=0x%x,LR=0x%x.",stacked_r0,stacked_r1,stacked_r2,stacked_r3,stacked_r12,stacked_lr);
	Bsp_printf("HardFault:PC=0x%x,PSR=0x%x,HFSR=0x%x,BFAR=0x%x,CFSR=0x%x,MMFAR=0x%x.",stacked_pc,stacked_psr,SCB->HFSR,SCB->BFAR,SCB->CFSR,SCB->MMFAR);
	*/
	SCB->HFSR=0xFFFFFFFF;
	SCB->CFSR=0xFFFFFFFF;
	
	while(1)
	{
		Bsp_printf("t0:%d,t1:%d,t2:%d,t3:%d,t4:%d.",testCnt[0],testCnt[1],testCnt[2],testCnt[3],testCnt[4]);
	}
	
}


/*
void HardFault_Handler(void)
{
#if 0
  const char *pError = ERR_INFO;
  uint8_t i;

  for (i = 0; i < sizeof(ERR_INFO); i++)
  {
     USART1->DR = pError[i];
     // 等待发送结束 
     while ((USART1->SR & USART_FLAG_TC) == (uint16_t)RESET);
  }
#endif

  // 当硬件失效异常发生时进入死循环
  while (1)
  {
		break;
  }
}
*/
/*
*********************************************************************************************************
*	函 数 名: MemManage_Handler
*	功能说明: 内存管理异常中断服务程序。违反MPU设定的存储器访问规则时触发。 复位时默认未使能
*	形    参: 无
*	返 回 值: 无
*********************************************************************************************************
*/
void MemManage_Handler(void)
{
  /* 当内存管理异常发生时进入死循环 */
  while (1)
  {
  }
}

/*
*********************************************************************************************************
*	函 数 名: BusFault_Handler
*	功能说明: 总线访问异常中断服务程序。取指令、数据读写、堆栈操作出现异常。 复位时默认未使能
*	形    参: 无
*	返 回 值: 无
*********************************************************************************************************
*/
void BusFault_Handler(void)
{
  /* 当总线异常时进入死循环 */
  while (1)
  {
  }
}

/*
*********************************************************************************************************
*	函 数 名: UsageFault_Handler
*	功能说明: 用法错误中断服务程序。执行未定义指令、非对齐操作、除零时触发。 复位时默认未使能
*	形    参: 无
*	返 回 值: 无
*********************************************************************************************************
*/
void UsageFault_Handler(void)
{
  /* 当用法异常时进入死循环 */
  while (1)
  {
  }
}

/*
*********************************************************************************************************
*	函 数 名: SVC_Handler
*	功能说明: 通过SWI指令的系统服务调用中断服务程序。
*	形    参: 无
*	返 回 值: 无
*********************************************************************************************************
*/
/*void SVC_Handler(void)
{
}*/

/*
*********************************************************************************************************
*	函 数 名: DebugMon_Handler
*	功能说明: 调试监视器中断服务程序。
*	形    参: 无
*	返 回 值: 无
*********************************************************************************************************
*/
void DebugMon_Handler(void)
{

}


void SysTick_Handler(void)
{
  //HAL_IncTick();
  osSystickHandler();
  MySysTick++;

/*
  opSysTick++;
  if(opSysTick>=10)    //!< 10ms
  	{	
  		opSysTick = 0;
		tickFlag = 'T';
  }
  */
	
}
/*
*********************************************************************************************************
*	函 数 名: PendSV_Handler
*	功能说明: 可挂起的系统服务调用中断服务程序。
*	形    参: 无
*	返 回 值: 无
*********************************************************************************************************
*/
/*void PendSV_Handler(void)
{
}*/

/***************************** 安富莱电子 www.armfly.com (END OF FILE) *********************************/
